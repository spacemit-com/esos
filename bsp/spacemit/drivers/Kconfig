## bsp/spacemit/drivers/Kconfig
```kconfig
menu "Hardware Drivers Config"

menu "Onboard Peripheral Drivers"

endmenu

menu "On-chip Peripheral Drivers"

    config BSP_USING_PIN
        bool "Enable PINTRL"
        select RT_USING_PIN
        default y

    config BSP_USING_GPIO
        bool "Enable GPIO"
        select RT_USING_GPIO
        default y

    if BSP_USING_GPIO
       config BSP_GPIO_TEST
          bool "Enable gpio test driver"
          default n
    endif

    config BSP_USING_UART
        bool "Enable UART"
        default y
        select RT_USING_SERIAL

    if BSP_USING_UART
       config BSP_UART_TEST
          bool "Enable uart test driver"
          default n
    endif

    config BSP_USING_ADMA
        bool "Enable ADMA"
        default n

    config BSP_USING_DMA
        bool "Enable DMA"
        default n

    if BSP_USING_DMA
       config BSP_DMA_TEST
          bool "Enable dma test driver"
          default n
    endif

    config BSP_USING_CAN
        bool "Enable CAN"
        default n
        select RT_USING_CAN
        select RT_CAN_USING_CANFD

    config BSP_USING_I2C
        bool "Enable I2C"
        default n

    config BSP_USING_WDT
        bool "Enable Watchdog"
        default n
        select RT_USING_WDT

    if BSP_USING_WDT
        config BSP_WDT_TEST
            bool "Enable wdt test"
            default n
    endif

    config BSP_USING_IR
        bool "Enable IR"
        default n

    config BSP_USING_PM
        bool "Enable PM"
        default n
        select RT_USING_PM

    config BSP_USING_PWM
        select RT_USING_PWM
        bool "Enable PWM"
        default n

    if BSP_USING_PWM
       config BSP_PWM_TEST
          bool "Enable pwm test driver"
          default n
    endif

    config BSP_USING_SPI
        bool "Enable SPI"
        default n
        select RT_USING_SPI

    if BSP_USING_SPI
       config BSP_SPI_TEST
          bool "Enable spi test driver"
          default n
    endif

    if BSP_USING_SPI || BSP_USING_DMA
       config BSP_SPI_DMA_TEST
          bool "Enable spi dma test driver"
          default n
    endif

    config BSP_USING_HWTIMER
        bool "Enable HWtimer"
        default n
        select RT_USING_HWTIMER

    if BSP_USING_HWTIMER
       config BSP_HWTIMER_TEST
          bool "Enable hwitmer test driver"
          default n
    endif

    config BSP_USING_HWSPINLOCK
        bool "Enable hwspinlock"
        default n
        select RT_USING_HWSPINLOCK

    config BSP_USING_MAILBOX
        bool "Enable MAILBOX"
        default n
        select RT_USING_MAILBOX

    if BSP_USING_MAILBOX
       config BSP_MAILBOX_TEST
          bool "Enable mailbox test driver"
          default n
    endif

    if BSP_USING_PIN
       config BSP_PIN_TEST
          bool "Enable pinctrl test driver"
          default n

       config BSP_PIN_WAKEUP_TEST
          bool "Enable pinctrl wakeup test driver"
          default n
    endif

    config BSP_USING_RPMSG
        bool "Enable rpmsg"
        default y
        select RT_USING_RPMSG_SERVICE

    if BSP_USING_RPMSG
       config BSP_RPROC_TEST
          bool "Enable rproc test driver"
          default n

       config BSP_USING_RPMSG_SERIAL
          bool "Enable rpmsg virtual serial (console over rpmsg)"
          default n
          select RT_USING_SERIAL
    endif

    config BSP_USING_REGULATOR
        bool "Enable regulator"
        default y
        select RT_USING_REGULATOR

    if BSP_USING_REGULATOR
       config BSP_REGULATOR_TEST
          bool "Enable regulator test driver"
          default n
    endif

    if BSP_USING_I2C
       config BSP_I2C_TEST
          bool "Enable I2C test driver"
          default n
    endif

    config BSP_USING_GMAC
        bool "Enable GMAC"
        default n

    if BSP_USING_GMAC
       config BSP_USING_MACCTL_TOOL
          bool "Enable MAC Control Tool"
          default n
    endif

    config BSP_TEST_RT
        bool "Enable RT test"
        default n
endmenu

menu "Board extended module Drivers"

endmenu

endmenu

config SOC_SPACEMIT
    bool "Spacemit platform"
    default y

if SOC_SPACEMIT

menu "Platform Config"

choice
    prompt "select chip type"
    default SOC_SPACEMIT_K1_X

    config SOC_SPACEMIT_K1_X
    bool "SOC_SPACEMIT_K1_X"
        select RT_USING_COMPONENTS_INIT
        select RT_USING_USER_MAIN
        select ARCH_RISCV32
        select RT_USING_CACHE


    config SOC_SPACEMIT_K3
    bool "SOC_SPACEMIT_K3"
        select RT_USING_COMPONENTS_INIT
        select RT_USING_USER_MAIN
        select ARCH_RISCV64
        select ARCH_RISCV_FPU
        select ARCH_RISCV_FPU_D
        select RT_USING_CACHE
endchoice

if SOC_SPACEMIT_K3
    choice
        prompt "select OS"
        default SOC_SPACEMIT_K3_CORE0

        config SOC_SPACEMIT_K3_CORE0
        bool "Energy OS"


        config SOC_SPACEMIT_K3_CORE1
        bool "Runtime OS"
    endchoice
endif
endmenu
endif
```
